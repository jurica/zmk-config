## boards/shields/cloq36/Kconfig.defconfig
```kconfig
# Copyright (c) 2023 The ZMK Contributors
# SPDX-License-Identifier: MIT

if SHIELD_CLOQ36

config ZMK_KEYBOARD_NAME
	default "cloq36"

endif
```

## boards/shields/humla/Kconfig.defconfig
```kconfig
# Copyright (c) 2024 The ZMK Contributors
# SPDX-License-Identifier: MIT

if SHIELD_HUMLA

config ZMK_KEYBOARD_NAME
    default "Humla"

endif
```

## config/boards/shields/cloq36/Kconfig.shield
```kconfig
# Copyright (c) 2023 The ZMK Contributors
# SPDX-License-Identifier: MIT

config SHIELD_CLOQ36
    def_bool $(shields_list_contains,cloq36)
```

## config/boards/shields/playpus_split/Kconfig.defconfig
```kconfig
# Copyright (c) 2025 The ZMK Contributors
# SPDX-License-Identifier: MIT

if SHIELD_PLATYPUS_SPLIT_LEFT

config ZMK_KEYBOARD_NAME
	default "Platypus Split"

config ZMK_SPLIT_ROLE_CENTRAL
	default y

endif

if SHIELD_PLATYPUS_SPLIT_LEFT || SHIELD_PLATYPUS_SPLIT_RIGHT

config ZMK_SPLIT
	default y

endif
```

## config/boards/shields/playpus_split/Kconfig.shield
```kconfig
# Copyright (c) 2025 The ZMK Contributors
# SPDX-License-Idertifier: MIT

config SHIELD_PLATYPUS_SPLIT_LEFT
    def_bool $(shields_list_contains,platypus_split_left)

config SHIELD_PLATYPUS_SPLIT_RIGHT
    def_bool $(shields_list_contains,platypus_split_right)
```
